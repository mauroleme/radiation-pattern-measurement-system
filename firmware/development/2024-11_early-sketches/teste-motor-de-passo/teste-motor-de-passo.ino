/*
======================================================================================================          
=====================================*%===============================================================          
==================================+%%*================================================================          
================================@@#===================================================================          
=============================*@#========================+#+===========================================          
==========================+%%+=======================+*@*=============================================          
=======================+%%*=======================+%%*==============+*================================          
=====================#%#=======================+#@+==============+@@*=================================          
================+%%@@*======================+%%+==============#@%+=============*%@@===================          
===============+@@@@*=+#*+===============*#%+==============#@#==============#@@#@#==================+=          
============+#%+======++*##+=++**+====+%#+=============+*%*=============*@%%@%+=================+#%#+=          
==========*#*=================+*%*+=+#@*+==========+*##+============+%@%@@+=================+#%%+=====          
=======+%#+=====================*##++**##+=++***@@@*=============*%@%@#+================+###+=========          
====+%%+====================++#*============+#@%@@#@@*+**====+@@@@@+=================*@%+=============          
=+%%*====================+%%*=============*%*+==*@@@%@@@#++%@@@*+================*#%*=================          
======================+%%+============+##+========#=@*#@@@@%@@#+++**++=======*%%*=====================          
====================#%+============###+===========#=@#@%++=+@+====++#@*++*@@@+========================          
===============================+#%*============*%%%=@======#@========+#%*+#@@*========================          
===========================================+@@#@*=*=@======@*====+%%+=================================          
========================================*@%@#+====*=%=====*@=*#%*=====================================          
==================================================*=@====+@@*=========================================          
==================================================+=%=+#**@===========================================          
==================================================#+@@@@@@@===========================================          
==================================================+=#====%@===========================================          
==================================================*=%====@%===========================================          
==================================================*=@===+@*===========================================
*/


#define DELAY_US 500  // Delay de 2 ms por micropasso

int M1dirpin = 7;   // Pino de direção do Motor X
int M1steppin = 6;  // Pino de passo do Motor X
int M1en = 8;       // Pino de habilitação do Motor X

void setup()
{
    pinMode(M1dirpin, OUTPUT);
    pinMode(M1steppin, OUTPUT);
    pinMode(M1en, OUTPUT);
    digitalWrite(M1en, LOW); // Habilita o Motor X
}

void loop()
{
    // 180° no sentido horário (36 incrementos de 5° = 10.080 micropassos)
    digitalWrite(M1dirpin, LOW); // Sentido horário
    for (int i = 0; i < 36; i++) // 36 incrementos de 5°
    {
        for (int j = 0; j < 280; j++) // 280 micropassos = 5°
        {
            step();
        }
        delay(500); // Pausa de 50 ms entre incrementos de 5°
    }
    delay(100); // Pausa de 2 segundos após 180°

    // 180° no sentido anti-horário (36 incrementos de 5° = 10.080 micropassos)
    digitalWrite(M1dirpin, HIGH); // Sentido anti-horário
    for (int i = 0; i < 36; i++) // 36 incrementos de 5°
    {
        for (int j = 0; j < 280; j++) // 280 micropassos = 5°
        {
            step();
        }
        delay(500); // Pausa de 50 ms entre incrementos de 5°
    }
    delay(500); // Pausa de 2 segundos após 180°
}

void step()
{
    digitalWrite(M1steppin, HIGH); // Pulso positivo para compatibilidade com drivers
    delayMicroseconds(DELAY_US);
    digitalWrite(M1steppin, LOW);
    delayMicroseconds(DELAY_US);
}